## src/board/Kconfig
```kconfig
menu "Board"

config HOMECORE_BOARD_CLOCK_SETUP
    bool "Configure the system clock at startup"
    default y
    help
        Let the board configure its clock tree (oscillators, PLL, bus
        prescalers) during board_init(). Disable only for emulators that do
        not model the clock controller, such as QEMU's STM32 machines; the
        board then assumes the emulator's fixed CPU clock. Boards without
        clock setup ignore this option.

endmenu
```

## src/kernel/Kconfig
```kconfig
menu "Kernel Configuration"

config HOMECORE_KERNEL_MAIN_STACK_SIZE
    int "Kernel stack size"
    default 3072
    range 256 8192
    help
        Bytes reserved at the top of RAM for the main stack, shared by the
        shell, BASIC, and interrupt handlers. File commands peak at about
        0.9 KB. BASIC needs about 910 bytes plus up to 230 bytes per nesting
        level, bounded by HOMECORE_SHELL_BASIC_MAX_NESTING: about 2.75 KB at
        the default of 8. The mem command reports the high-water mark.
        Overflow is not detected and corrupts the heap.

config HOMECORE_KERNEL_STDIO_BUFFERED
    bool "Buffer standard input and output"
    default y
    help
        Let newlib allocate its default buffers for stdin and stdout on first
        use, about 1 KB each from the heap. Disable on small-RAM boards to make
        both streams unbuffered; each character then passes directly to the
        console device.

endmenu
```

## src/subsystems/Kconfig
```kconfig
menu "Subsystems"

rsource "shell/Kconfig"
rsource "vfs/Kconfig"
rsource "fs/Kconfig"

endmenu
```

## src/subsystems/fs/Kconfig
```kconfig
menu "Filesystems"

config HOMECORE_FS_FAT_VOLUMES
    int "Maximum number of mounted FAT volumes"
    default 2
    range 1 4
    help
        FAT volumes that can be mounted at once, for example a ramdisk and an
        SD card. Board descriptions mount volumes in their mounts section.

config HOMECORE_FS_FAT_LFN
    bool "Long file names on FAT volumes"
    default y
    help
        Support names beyond the 8.3 format. Adds about 3 KB of code and a
        512-byte heap buffer during each file-name operation. Without it, only
        8.3 names can be created or opened.

config HOMECORE_FS_FAT_TINY
    bool "Share one sector buffer per FAT volume"
    default n
    help
        Save about 512 bytes of heap per open FAT file at some speed cost.
        Useful on small-RAM boards.

endmenu
```

## src/subsystems/shell/Kconfig
```kconfig
menu "Shell"

config HOMECORE_SHELL
    bool "Enable shell subsystem"
    default y

if HOMECORE_SHELL

config HOMECORE_SHELL_PROMPT
    string "Shell prompt suffix (after user and cwd)"
    default "$ "

config HOMECORE_SHELL_MAX_INPUT_LENGTH
    int "Maximum shell input length"
    default 128 

config HOMECORE_SHELL_MAX_ARGS
    int "Maximum number of arguments for shell commands"
    default 10
    range 1 20

config HOMECORE_SHELL_BASIC_MAX_NESTING
    int "Maximum BASIC expression nesting"
    default 8
    range 1 32
    help
        Maximum nesting of parentheses, unary signs, function calls, and
        IF-THEN statements in one BASIC line. Deeper lines fail with
        "expression too deeply nested" instead of overflowing the stack. The
        parser recurses once per level: measured costs are up to about 230
        bytes per level (nested function calls, Debug build) on top of about
        910 bytes for BASIC at depth 0. Keep HOMECORE_KERNEL_MAIN_STACK_SIZE
        at least 910 + 230 * this value, plus a margin. Sets G2Basic's
        G2BASIC_MAX_NESTING.

endif

endmenu
```

## src/subsystems/vfs/Kconfig
```kconfig
menu "Virtual File System"

config HOMECORE_VFS
    bool "Enable Virtual File System"
    default y
    help
        Enable the virtual file system (VFS) subsystem.

if HOMECORE_VFS

config HOMECORE_VFS_MAX_DIRECTORIES
    int "Maximum number of user-created RAM directories"
    default 16
    range 1 64
    help
        Cap on RAM directories. Each is allocated from the heap when created,
        sized to its path, and freed when removed.

config HOMECORE_VFS_MAX_RAM_FILES
    int "Maximum number of RAM files"
    default 16
    range 1 64
    help
        Cap on RAM files. Each entry is allocated from the heap when created,
        sized to its path, and freed when removed; contents are allocated
        separately when written.

config HOMECORE_VFS_MAX_FILE_SIZE
    int "Maximum size of each RAM file in bytes"
    default 4096
    range 1 32768

config HOMECORE_VFS_MAX_MOUNTS
    int "Maximum number of mounted filesystems"
    default 2
    range 1 8
    help
        Mount points, such as /ram and /sd, that can exist at once. Each costs
        a small static entry.

config HOMECORE_VFS_MAX_OPEN_FILES
    int "Maximum number of open files"
    default 16
    range 4 64
    help
        Set the maximum number of files that can be opened simultaneously.
        The VFS keeps one pointer per descriptor and allocates each descriptor
        from the heap when opened. The three standard streams use three.

endif

endmenu
```
